#pragma once

#include <Arduino.h>
#include <ESP8266HTTPClient.h>
#include <WiFiClientSecureBearSSL.h>
#include <memory>

// Bounded samples measure this ESP's throughput, not the ISP line capacity.
class EspSpeedTest {
 public:
  static constexpr uint32_t INTERVAL_MS = 300000;
  static constexpr uint32_t DOWNLOAD_BYTES = 524288;
  static constexpr uint32_t UPLOAD_BYTES = 131072;

  void begin() { lastStartedAt_ = millis(); }
  bool busy() const { return state_ != State::IDLE; }
  bool running() const { return state_ == State::DOWNLOADING || state_ == State::UPLOAD_READY; }
  bool hasResult() const { return hasResult_; }
  float downloadMbps() const { return downloadMbps_; }
  float uploadMbps() const { return uploadMbps_; }
  uint32_t resultAgeSeconds() const { return (millis() - resultAt_) / 1000; }

  uint32_t nextTestSeconds() const {
    uint32_t elapsed = millis() - lastStartedAt_;
    return elapsed >= INTERVAL_MS ? 0 : (INTERVAL_MS - elapsed + 999) / 1000;
  }

  String status() const {
    switch (state_) {
      case State::QUEUED: return F("Queued: waiting for connectivity check");
      case State::DOWNLOADING: return F("Testing download");
      case State::UPLOAD_READY: return F("Testing upload");
      default: return lastStatus_;
    }
  }

  bool request() {
    if (busy()) return false;
    state_ = State::QUEUED;
    return true;
  }

  void cancel(const String &reason) {
    if (!busy()) return;
    finish(reason);
  }

  // Called from loop(), never from a web handler. The download drains in slices.
  void update(bool automatic, bool canStart, bool connected) {
    uint32_t now = millis();
    if (!connected) {
      cancel(F("Cancelled: WiFi disconnected"));
      return;
    }
    if (state_ == State::IDLE && automatic && now - lastStartedAt_ >= INTERVAL_MS) request();
    if (state_ == State::QUEUED) {
      if (canStart) startDownload();
      return;
    }
    if (!running()) return;
    if (now - testStartedAt_ >= 30000UL) {
      finish(F("Failed: test time limit"));
      return;
    }
    if (state_ == State::UPLOAD_READY) {
      runUpload();
      return;
    }
    if (now - phaseStartedAt_ >= 15000UL || now - lastDataAt_ >= 3000UL) {
      finish(F("Failed: download timeout"));
      return;
    }
    uint8_t buffer[1024];
    // A per-loop budget leaves time for portal requests, display and relay work.
    uint32_t sliceAt = millis();
    uint32_t budget = 8192;
    while (client_->available() > 0 && received_ < DOWNLOAD_BYTES && budget && millis() - sliceAt < 5) {
      size_t count = min(size_t(client_->available()), sizeof(buffer));
      count = min(count, size_t(DOWNLOAD_BYTES - received_));
      count = min(count, size_t(budget));
      int bytes = client_->read(buffer, count);
      if (bytes <= 0) break;
      received_ += bytes;
      budget -= bytes;
      lastDataAt_ = millis();
    }
    if (received_ == DOWNLOAD_BYTES) {
      uint32_t duration = millis() - phaseStartedAt_;
      if (duration == 0) {
        finish(F("Failed: download duration too short"));
        return;
      }
      pendingDownloadMbps_ = megabitsPerSecond(received_, duration);
      closeConnection();
      state_ = State::UPLOAD_READY;
    } else if (!client_->connected() && !client_->available()) {
      finish(F("Failed: incomplete download"));
    }
  }

 private:
  enum class State : uint8_t { IDLE, QUEUED, DOWNLOADING, UPLOAD_READY };

  // Generate a fixed-size payload without allocating it or writing to flash.
  class UploadSource : public Stream {
   public:
    int available() override { return millis() - startedAt_ < 15000UL ? remaining_ : 0; }
    uint32_t remaining() const { return remaining_; }
    bool inputCanTimeout() override { return false; }
    int read() override {
      if (!available()) return -1;
      --remaining_;
      return uint8_t(remaining_ * 31U);
    }
    int peek() override { return available() ? uint8_t((remaining_ - 1) * 31U) : -1; }
    void flush() override {}
    size_t write(uint8_t) override { return 0; }
   private:
    uint32_t remaining_ = UPLOAD_BYTES;
    uint32_t startedAt_ = millis();
  };

  static float megabitsPerSecond(uint32_t bytes, uint32_t durationMs) {
    return float(bytes) * 8.0f / (float(durationMs) * 1000.0f);
  }

  bool openConnection(const String &path) {
    client_.reset(new BearSSL::WiFiClientSecure());
    // Measurement traffic contains only generated bytes, no credentials.
    client_->setInsecure();
    client_->setTimeout(4000);
    client_->setBufferSizes(16384, 1024);
    http_.setTimeout(4000);
    http_.useHTTP10(true);
    http_.setReuse(false);
    return http_.begin(*client_, String("https://speed.cloudflare.com") + path);
  }

  void startDownload() {
    // BearSSL needs working heap in addition to the existing web interface.
    if (ESP.getFreeHeap() < 28000 || ESP.getMaxFreeBlockSize() < 18000) {
      lastStartedAt_ = millis();
      finish(F("Failed: insufficient free memory"));
      return;
    }
    lastStartedAt_ = testStartedAt_ = millis();
    received_ = 0;
    state_ = State::DOWNLOADING;
    if (!openConnection("/__down?bytes=" + String(DOWNLOAD_BYTES))) {
      finish(F("Failed: download setup"));
      return;
    }
    // Include DNS, TLS and request overhead: intentionally a conservative score.
    phaseStartedAt_ = millis();
    int code = http_.GET();
    if (code != HTTP_CODE_OK || http_.getSize() != int(DOWNLOAD_BYTES)) {
      finish("Failed: download HTTP " + String(code));
      return;
    }
    lastDataAt_ = millis();
  }

  void runUpload() {
    if (!openConnection(F("/__up"))) {
      finish(F("Failed: upload setup"));
      return;
    }
    http_.addHeader(F("Content-Type"), F("application/octet-stream"));
    UploadSource source;
    source.setTimeout(1500);
    uint32_t startedAt = millis();
    int code = http_.sendRequest("POST", &source, UPLOAD_BYTES);
    uint32_t duration = millis() - startedAt;
    if (code < 200 || code >= 300 || source.remaining() != 0 || duration == 0 || millis() - testStartedAt_ >= 30000UL) {
      finish("Failed: upload HTTP " + String(code));
      return;
    }
    downloadMbps_ = pendingDownloadMbps_;
    uploadMbps_ = megabitsPerSecond(UPLOAD_BYTES, duration);
    resultAt_ = millis();
    hasResult_ = true;
    finish(F("Complete"));
  }

  void closeConnection() {
    http_.end();
    if (client_) client_->stop();
    client_.reset();
  }

  void finish(const String &message) {
    closeConnection();
    lastStatus_ = message;
    state_ = State::IDLE;
  }

  State state_ = State::IDLE;
  HTTPClient http_;
  std::unique_ptr<BearSSL::WiFiClientSecure> client_;
  String lastStatus_ = "Not tested yet";
  bool hasResult_ = false;
  uint32_t lastStartedAt_ = 0;
  uint32_t testStartedAt_ = 0;
  uint32_t phaseStartedAt_ = 0;
  uint32_t lastDataAt_ = 0;
  uint32_t received_ = 0;
  uint32_t resultAt_ = 0;
  float pendingDownloadMbps_ = 0;
  float downloadMbps_ = 0;
  float uploadMbps_ = 0;
};
